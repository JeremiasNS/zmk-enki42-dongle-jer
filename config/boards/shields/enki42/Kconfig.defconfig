## config/boards/shields/enki42/Kconfig.defconfig
```kconfig
# Copyright (c) 2020 The ZMK Contributors
# SPDX-License-Identifier: MIT

# Copyright (c) 2020 The ZMK Contributors
# SPDX-License-Identifier: MIT

if SHIELD_ENKI42_DONGLE
config ZMK_KEYBOARD_NAME
    default "Enki42"
config ZMK_SPLIT_ROLE_CENTRAL
    default y
config ZMK_SPLIT
    default y
config ZMK_SPLIT_BLE_CENTRAL_PERIPHERALS
    default 2
config BT_MAX_CONN
    default 7
config BT_MAX_PAIRED
    default 7
config ZMK_USB
    default y
config ZMK_BLE
    default y
endif # SHIELD_ENKI42_DONGLE

if SHIELD_ENKI42_LEFT || SHIELD_ENKI42_RIGHT
config ZMK_SPLIT
    default y
config ZMK_BLE
    default y
endif # SHIELD_ENKI42_LEFT || SHIELD_ENKI42_RIGHT
```

## config/west.yml
```yaml
manifest:
  remotes:
    - name: zmkfirmware
      url-base: https://github.com/zmkfirmware
    - name: Tee-nahan
      url-base: https://github.com/Tee-nahan/zmk-dongle-display
  projects:
    - name: zmk
      remote: zmkfirmware
      revision: main
      import: app/west.yml
    - name: zmk-dongle-display
      remote: Tee-nahan
      revision: main
  self:
    path: config
```
